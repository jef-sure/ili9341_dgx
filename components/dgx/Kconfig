## components/dgx/Kconfig
```kconfig
menu "Display Graphics"

    config DGX_ENABLE_SPI
        bool "Enable the SPI interface displays."
        help
            This enables the SPI interface displays.

    config DGX_ENABLE_SPI_ST7735
        bool "Enable the SPI TFT displays on ST7735 chip."
        depends on DGX_ENABLE_SPI
        help
            This enables the SPI TFT displays on ST7735 chip.

    config DGX_ENABLE_SPI_ST7789
        bool "Enable the SPI TFT displays on ST7789 chip."
        depends on DGX_ENABLE_SPI
        help
            This enables the SPI TFT displays on ST7789 chip.

    config DGX_ENABLE_SPI_SSD_1306
        bool "Enable the SPI OLED displays on SSD 1306 chip."
        depends on DGX_ENABLE_SPI
        help
            This enables the SPI OLED displays on SSD 1306 chip.

    config DGX_ENABLE_SPI_ILI_9341
        bool "Enable the SPI interface displays on ILI 9341 chip."
        depends on DGX_ENABLE_SPI
        help
            This enables the SPI interface displays on ILI 9341 chip.

    config DGX_ENABLE_I2C
        bool "Enable the I2C interface displays."
        help
            This enables the I2C interface displays.

    config DGX_ENABLE_I2C_SSD_1306
        bool "Enable the I2C OLED displays on SSD 1306 chip."
        depends on DGX_ENABLE_I2C
        help
            This enables the I2C OLED displays on SSD 1306 chip.

    config DGX_ENABLE_P8
        bool "Enable the parallel 8 bit interface displays."
        help
            This enables the parallel 8 bit interface displays.

    config DGX_ENABLE_P8_ILI_9341
        bool "Enable the parallel interface displays on ILI 9341 chip."
        depends on DGX_ENABLE_P8
        help
            This enables the parallel interface displays on ILI 9341 chip.



endmenu
```

## main/Kconfig.projbuild
```kconfig
# put here your custom config value
menu "Example Configuration"
config ESP_WIFI_SSID
    string "WiFi SSID"
    default "myssid"
    help
	SSID (network name) for the example to connect to.

config ESP_WIFI_PASSWORD
    string "WiFi Password"
    default "mypassword"
    help
	WiFi password (WPA or WPA2) for the example to use.

config ESP_IPINFO_TOKEN
	string "Token for API of ipinfo.io"
	default "0123467890"
	
config WEATHER_API_KEY
	string "Token for API of openweathermap.org"
	default "0123467890"

endmenu
```
